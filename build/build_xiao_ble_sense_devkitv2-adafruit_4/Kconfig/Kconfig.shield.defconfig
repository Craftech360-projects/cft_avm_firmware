## build/build_xiao_ble_sense_devkitv2-adafruit_4/Kconfig/Kconfig.shield.defconfig
```kconfig
osource "c:/users/pavan/cft_avm_firmware/boards/shields/*/Kconfig.defconfig"
osource "C:/ncs/v2.6.1/nrf/boards/shields/*/Kconfig.defconfig"
```

## build/build_xiao_ble_sense_devkitv2-adafruit_new/Kconfig/Kconfig.shield
```kconfig
osource "c:/users/pavan/cft_avm_firmware/boards/shields/*/Kconfig.shield"
osource "C:/ncs/v2.6.1/nrf/boards/shields/*/Kconfig.shield"
```

## build_nrf52840/Kconfig/Kconfig.shield.defconfig
```kconfig
osource "c:/avm_testing/omi-omi_dk2_v2.0.7/friend/firmware/firmware_v1.0/boards/shields/*/Kconfig.defconfig"
osource "C:/ncs/v2.6.1/nrf/boards/shields/*/Kconfig.defconfig"
```
